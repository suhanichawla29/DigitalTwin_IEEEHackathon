VERSION ""

NS_ :

BS_:

BU_: ECU

BO_ 256 ECU_Telemetry: 8 ECU
 SG_ Voltage : 0|16@1+ (0.1,0) [0|1000] "V" ECU
 SG_ Current : 16|16@1+ (0.1,0) [0|1000] "A" ECU
 SG_ Temperature : 32|16@1+ (0.1,-40) [-40|200] "degC" ECU
SG_ Voltage : 0|16@1+ (0.1,0) [0|1000] "V" ECU
